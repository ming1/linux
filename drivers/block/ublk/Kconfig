## drivers/block/ublk/Kconfig
```kconfig
# SPDX-License-Identifier: GPL-2.0

config BLK_DEV_UBLK
	tristate "Userspace block driver (Experimental)"
	select IO_URING
	help
	  io_uring based userspace block driver. Together with ublk server, ublk
	  has been working well, but interface with userspace or command data
	  definition isn't finalized yet, and might change according to future
	  requirement, so mark is as experimental now.

config BLKDEV_UBLK_LEGACY_OPCODES
	bool "Support legacy command opcode"
	depends on BLK_DEV_UBLK
	default y
	help
	  ublk driver started to take plain command encoding, which turns out
	  one bad way. The traditional ioctl command opcode encodes more
	  info and basically defines each code uniquely, so opcode conflict
	  is avoided, and driver can handle wrong command easily, meantime it
	  may help security subsystem to audit io_uring command.

	  Say Y if your application still uses legacy command opcode.

	  Say N if you don't want to support legacy command opcode. It is
	  suggested to enable N if your application(ublk server) switches to
	  ioctl command encoding.
```
