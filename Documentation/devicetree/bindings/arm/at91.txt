## Documentation/devicetree/bindings/arm/at91.txt
```
Atmel AT91 device tree bindings.
========================================

PIT Timers required properties:
    - compatible = "atmel,at91sam9260-pit"
    - interrupts : The single IRQ line for the timer.
    - reg : The register bank for the timer.
```

## Documentation/devicetree/bindings/crypto/mv_cesa.txt
```
Marvell Cryptographic Engines And Security Accelerator

Required properties:
- compatible : should be "mrvl,orion-crypto"
- reg : base physical address of the engine and length of memory mapped
        region, followed by base physical address of sram and its memory
		length
- interrupts : interrupt number

Examples:

crypto@f1030000 {
	compatible = "mrvl,orion-crypto";
	reg = <0xf1030000 0x10000
	       0xf5000000 0x800>;    /* sram */
	interrupts = <22>;
};
```

## Documentation/devicetree/bindings/gpio/gpio_at91.txt
```
Atmel AT91 GPIO controller

Required properties:
 - compatible : "atmel,at91rm9200-gpio"
 - interrupts : Should be the port interrupt shared by all 32 pins.
 - #gpio-cells : Should be two.  The first cell is the pin number and
  the second cell is used to specify optional parameters (currently
  unused).
 - gpio-controller : Marks the device node as a GPIO controller.
```

## Documentation/devicetree/bindings/gpio/pl061-gpio.txt
```
ARM PL061 GPIO controller

Required properties:
- compatible : "arm,pl061", "arm,primecell"
- #gpio-cells : Should be two. The first cell is the pin number and the
  second cell is used to specify optional parameters:
  - bit 0 specifies polarity (0 for normal, 1 for inverted)
- gpio-controller : Marks the device node as a GPIO controller.
- interrupts : Interrupt mapping for GPIO IRQ.

Optional properties:
- interrupt-controller : Identifies the node as an interrupt controller. Must
  be present if using gpios lines for interrupts.
- #interrupt-cells : Specifies the number of cells needed to encode an
  interrupt source.  The type shall be a <u32> and the value shall be 2.

  The 1st cell contains the interrupt number 0-7 corresponding to the gpio
  line.

  The 2nd cell is the flags, encoding trigger type and level flags.
	1 = low-to-high edge triggered
	2 = high-to-low edge triggered
	4 = active high level-sensitive
	8 = active low level-sensitive
```

## Documentation/devicetree/bindings/i2c/max6697.txt
```
max6697 properties

Required properties:
- compatible:
	Should be one of
		maxim,max6581
		maxim,max6602
		maxim,max6622
		maxim,max6636
		maxim,max6689
		maxim,max6693
		maxim,max6694
		maxim,max6697
		maxim,max6698
		maxim,max6699
- reg: I2C address

Optional properties:
- smbus-timeout-disable
	Set to enable SMBus timeout
- extended-range-enable
	Only valid for MAX6581. Set to enable extended temperature range.
- alert-mask
	Alert bit mask. Alert disabled for bits set.
- over-temperature-mask
	Over temperature bit mask. Over temperature reporting disabled for
	bits set.
- resistance-cancellation
	Boolean for all chips other than MAX6581. Enabled if set.
	For MAX6581, resistance cancellation enabled for all channels if
	specified as boolean, otherwise as per bit mask specified.
- transistor-ideality
	For MAX6581 only. Two values; first is bit mask, second is ideality
	select value as per MAX6581 data sheet.

Example:

temp-sensor@1a {
	compatible = "maxim,max6697";
	reg = <0x1a>;
	smbus-timeout-disable;
	resistance-cancellation;
	alert-mask = <0xff>;
	over-temperature-mask = <0xff>;
};
```

## Documentation/devicetree/bindings/i2c/nomadik.txt
```
I2C for Nomadik based systems

Required (non-standard) properties:
 - Nil

Recommended (non-standard) properties:
 - clock-frequency : Maximum bus clock frequency for the device
 - stericsson,slsu : Data line delay
 - stericsson,tft : Tx FIFO threshold
 - stericsson,rft : Rx FIFO threshold
 - stericsson,timeout : Slave response timeout(ms)
 - stericsson,i2c_freq_mode_fast : I2C fast mode (omit for standard mode)

Optional (non-standard) properties:
 - Nil

Example :

i2c@80004000 {
        compatible = "stericsson,db8500-i2c", "st,nomadik-i2c";
        reg = <0x80004000 0x1000>;
        interrupts = <0 21 0x4>;
        #address-cells = <1>;
        #size-cells = <0>;
        v-i2c-supply = <&db8500_vape_reg>;

        clock-frequency = <100000>;
        stericsson,slsu = <0xe>;
        stericsson,tft = <1>;
        stericsson,rft = <8>;
        stericsson,timeout = <200>;
        stericsson,i2c_freq_mode_fast;
};
```

## Documentation/devicetree/bindings/pinctrl/renesas,pfc-pinctrl.txt
```
* Renesas GPIO and Pin Mux/Config controller

Required Properties:
- compatible: should be one of the following.
  - "renesas,pfc-r8a7740": for R8A7740 (R-Mobile A1) compatible pin-controller.
  - "renesas,pfc-r8a7779": for R8A7779 (R-Car H1) compatible pin-controller.
  - "renesas,pfc-sh7372": for SH7372 (SH-Mobile AP4) compatible pin-controller.
  - "renesas,pfc-sh73a0": for SH73A0 (SH-Mobile AG5) compatible pin-controller.

- reg: Base address and length of each memory resource used by the pin
  controller hardware module.

- gpio-controller: Marks the device node as a gpio controller.

- #gpio-cells: Should be 2. The first cell is the pin number and the second cell
  is used to specify optional parameters as bit flags. Only the GPIO active low
  flag (bit 0) is currently supported.


The PFC node also acts as a container for pin control maps represented as
subnodes. Each subnode contains a function name and one or more pin or pin group
name. The subnode names are ignored, all subnodes are parsed through phandles
and processed purely based on their content.

Required Subnode Properties:
- renesas,pins : An array of strings. Each string contains the name of a pin or
  pin group.
- renesas,function: A string containing the name of the function to mux to the
  pin or pin group.

  Valid values for group and function names can be found in the group and
  function arrays of the PFC data file corresponding to the SoC
  (drivers/pinctrl/spear/pfc-*.c)

Please refer to pinctrl-bindings.txt in this directory for details of the common
pinctrl bindings used by client devices.


The syntax of the gpio specifier used by client nodes should be the following
with values derived from the SoC user manual.

  <[phandle of the gpio controller node]
   [pin number within the gpio controller]
   [flags and pull up/down]>


Example 1: SH73A0 (SH-Mobile AG5) pin controller node

	gpio: pfc@e6050000 {
		compatible = "renesas,pfc-sh73a0";
		reg = <0xe6050000 0x8000>,
		      <0xe605801c 0x1c>;
		gpio-controller;
		#gpio-cells = <2>;
	};

Example 2: A GPIO LED node that references a GPIO

	leds {
		compatible = "gpio-leds";
		led1 {
			gpios = <&gpio 20 1>; /* Active low */
		};
	};

Example 3: KZM-A9-GT (SH-Mobile AG5) default pin state and pin control maps
           for the LCD device

	&gpio {
		pinctrl-0 = <&lcd_pins>;
		pinctrl-names = "default";

		lcd_pins: pfc_lcd_pins {
			renesas,pins = "lcd_data24", "lcd_sync";
			renesas,function = "lcd";
		};
	};
```

## Documentation/devicetree/bindings/sh/intc.txt
```
* Renesas SuperH / SH-MOBILE Interrupt Controller

The SH/INTC driver is used by SuperH and ARM/SH-MOBILE.
At the moment, SuperH does not have the plan corresponding to DT.
DT of SH/INTC has taken the form where the table data of the C
is managed by DT, in order to maintain compatibility.

The main node requires the following properties:

- compatible : "renesas,sh-intc"

- interrupt-controller  : Identifies the node as an interrupt controller
- #interrupt-cells      : Must be 1
- #address-cells        : Must be 1
- #size-cells           : Must be 1
- ranges                : Empty as we have a 1-1 mapping to parent's
                          address space
- reg                   : Specifies base physical address(s) and size of
                          the INTC registers
- intsrc*               : Interrupt source
                          Associate an interrupt source with its vector

- *_registers           : These describe the vector table, mask, priority, ack,
                          and sense registers. It must contain the following:

 -- intc_vectors	: This describes the interrupt sources
    This node requires the following property:
	*vector_table	: List of interrupt sources

 -- intc_mask_registers : This specifies the contents of the mask registers
    This node requires the following properties:
        * address-cells : Must be 1
        * size-cells    : Must be 1
        * ranges        : Empty as we have a 1-1 mapping to parent's
                          address space
        * intc_mask*    : A mask register
	  This node requires the following properties:
          ** reg        : This specifies the address of mask registers.
                          The first entry specifies the mask register and
                          the second entry specifies the mask clear
                          register.  The first cell is the register's
                          address, and the second cell is the register's size
                          which must be 1, 2 or 4 bytes.
          ** reginfo    : This specifies the interrupt sources controlled by
                          the mask. The list entries correspond to bits of
                          the mask from most to least significant.  A value
                          of 0 may be used for unused bits in the mask.
                          Trailing list entries may be omitted in which
                          case they will be treated as 0.

 -- intc_prio_registers : This sets up the contents of the priority registers
    This node requires the following properties:
        * address-cells : Must be 1
        * size-cells    : Must be 1
        * ranges        : Empty as we have a 1-1 mapping to parent's
                          address space
        * intc_prio*	: A sense register
	  This node requires the following properties:
          ** reg        : This specifies the address of the priority register.
                          The first entry specifies the priority set
                          register and the second entry specifies priority
                          clear register.  The first cell is the register's
                          address, and the second cell is the register's
                          size which must be 1, 2 or 4 bytes.  If there is
                          not priority clear register then they entry may
                          be omitted or 0 used as the register's address.
          ** field-width: Width of each group in the register in bits.
                          A group contains the priority for a single
                          interrupt vector. Thus a 16 bit register with
                          a field-width of 4 may control the priority for
                          4 (16 / 4) interrupt sources.
          ** reginfo    : This specifies the interrupt sources or interrupt
                          source groups controlled by the priority register.
                          The list entries correspond to the groups of the
                          priority register from least to most significant.
                          A value of 0 may be used for unused groups.
                          Trailing list entries may be omitted in which
                          case they will be treated as 0.

 -- intc_sense_registers : This sets up the contents of the sense registers
    This node requires the following properties:
        * address-cells : Must be 1
        * size-cells    : Must be 1
        * ranges        : Empty as we have a 1-1 mapping to parent's
                          address space
        * intc_prio*	: A sense register
	  This node requires the following properties:
          ** reg        : This specifies the address of the sense register.
                          The first cell is the register's address, and the
                          second cell is the register's size which must be
                          1, 2 or 4 bytes.
          ** field-width: Width of each group in the register in bits.
                          A group contains the priority for a single
                          interrupt vector. Thus a 16 bit register with
                          a field-width of 4 may control the priority for
                          4 (16 / 4) interrupt sources.
          ** reginfo    : This specifies the interrupt sources controlled by
                          the sense register.  The list entries correspond
                          to the groups of the priority register from least
                          to most significant.  A value of 0 may be used
                          for unused groups.  Trailing list entries may be
                          omitted in which case they will be treated as 0.

 -- intc_ack_registers   : This sets up the contents of the ACK registers
    This node requires the following properties:
        * address-cells : Must be 1
        * size-cells    : Must be 1
        * ranges        : Empty as we have a 1-1 mapping to parent's
                          address space
        * intc_ack*	: An ACK registers
	  This node requires the following properties:
          ** reg        : This specifies the address of the ACK register.
                          The first cell is the register's address, and the
                          second cell is the register's size which must be
                          1, 2 or 4 bytes.
          ** reginfo    : This specifies the interrupt sources controlled by
                          the ACK register. The list entries correspond to
                          bits of the ACK register from most to least
                          significant.  A value of 0 may be used for unused
                          bits in the mask.  Trailing list entries may be
                          omitted in which case they will be treated as 0.

Optional:

- intc_groups		: The interrupt source groups
                          Interrupt sources may be grouped with a group
                          sharing the same bits of an interrupt priority
                          register.
    This node requires the following property:
	* intc_group*   : An interrupt source group
	  This node requires the following property:
          ** group      : The list of interrupt sources that
                          belong to the group.

- intc_intevtsa	: This sets up the contents of INTEVTSA.
	This node requires the following properties:
	  * vector : This specifies the interrupt source

Example:

	intca: interrupt-controller@0 {
		compatible = "renesas,sh_intc";
		interrupt-controller;
		#address-cells = <1>;
		#size-cells = <1>;
		#interrupt-cells = <1>;
		ranges;

		reg = <0xe6940000 0x200>, <0xe6950000 0x200>;
		group_size = <19>;

		DIRC: intsrc1 { vector = <0x0560>; };
		ATAPI: intsrc2 { vector = <0x05E0>; };
		....

		DMAC1_1: intc_group0 { group = <&DMAC1_1_DEI0 &DMAC1_1_DEI1
				&DMAC1_1_DEI2 &DMAC1_1_DEI3>; };
		DMAC1_2: intc_group1 { group = <&DMAC1_2_DEI4 &DMAC1_2_DEI5
						 &DMAC1_2_DADERR>; };
		....
		intc_vectors {
			vector_table = <&DIRC &ATAPI &IIC1_ALI &IIC1_TACKI &IIC1_WAITI,
		....
		};

		intc_mask_registers {
			#address-cells = <1>;
			#size-cells = <1>;
			ranges;

			intc_mask0 {
				reg = <0xe6940080 1>, <0xe69400c0 1>;
				reginfo = <&DMAC2_1_DEI3 &DMAC2_1_DEI2 &DMAC2_1_DEI1
					&DMAC2_1_DEI0 0 0 &AP_ARM_COMMTX &AP_ARM_COMMRX>;
			};
			....
		};

		intc_prio_registers {
			#address-cells = <1>;
			#size-cells = <1>;
			ranges;

			intc_prio0 {
				reg = <0xe6940000 2>;
				field-width = <4>;
				reginfo = <&DMAC3_1 &DMAC3_2 &CMT2 &ICBS0>;
			};
			....
		};
	};
```

## Documentation/devicetree/bindings/usb/ehci-orion.txt
```
Marvell Orion SoC USB controller

Required properties :
 - compatible : should be "mrvl,orion-ehci".
 - phy_version : should be "orion".
```
