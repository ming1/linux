## arch/mips/configs/falcon_defconfig
```kconfig
CONFIG_LANTIQ=y
CONFIG_SOC_FALCON=y
CONFIG_CPU_MIPS32_R2=y
CONFIG_HIGH_RES_TIMERS=y
CONFIG_EXPERIMENTAL=y
CONFIG_DEFAULT_HOSTNAME="falcon"
CONFIG_SYSVIPC=y
CONFIG_LOG_BUF_SHIFT=14
CONFIG_BLK_DEV_INITRD=y
CONFIG_INITRAMFS_ROOT_UID=1000
CONFIG_INITRAMFS_ROOT_GID=1000
CONFIG_RD_LZMA=y
CONFIG_EMBEDDED=y
CONFIG_SLAB=y
CONFIG_MODULES=y
CONFIG_MODULE_UNLOAD=y
CONFIG_DEFAULT_DEADLINE=y
# CONFIG_SUSPEND is not set
CONFIG_NET=y
CONFIG_PACKET=y
CONFIG_UNIX=y
CONFIG_INET=y
CONFIG_IP_MULTICAST=y
CONFIG_IP_ADVANCED_ROUTER=y
CONFIG_IP_MULTIPLE_TABLES=y
CONFIG_IP_ROUTE_MULTIPATH=y
CONFIG_IP_ROUTE_VERBOSE=y
CONFIG_IP_MROUTE=y
CONFIG_IP_MROUTE_MULTIPLE_TABLES=y
CONFIG_ARPD=y
CONFIG_SYN_COOKIES=y
CONFIG_NETFILTER=y
CONFIG_BRIDGE=m
CONFIG_VLAN_8021Q=y
CONFIG_NET_SCHED=y
CONFIG_UEVENT_HELPER_PATH="/sbin/hotplug"
CONFIG_MTD=y
CONFIG_MTD_CMDLINE_PARTS=y
CONFIG_MTD_CHAR=y
CONFIG_MTD_BLOCK=y
CONFIG_MTD_CFI=y
CONFIG_MTD_CFI_ADV_OPTIONS=y
CONFIG_MTD_CFI_GEOMETRY=y
CONFIG_MTD_CFI_INTELEXT=y
CONFIG_MTD_CFI_AMDSTD=y
CONFIG_MTD_COMPLEX_MAPPINGS=y
CONFIG_MTD_LANTIQ=y
CONFIG_MTD_M25P80=y
CONFIG_MISC_DEVICES=y
CONFIG_EEPROM_AT24=y
CONFIG_NETDEVICES=y
CONFIG_MII=y
CONFIG_PHYLIB=y
# CONFIG_INPUT_MOUSEDEV is not set
# CONFIG_KEYBOARD_ATKBD is not set
CONFIG_KEYBOARD_GPIO=y
CONFIG_KEYBOARD_GPIO_POLLED=y
# CONFIG_INPUT_MOUSE is not set
# CONFIG_SERIO is not set
# CONFIG_VT is not set
# CONFIG_LEGACY_PTYS is not set
# CONFIG_DEVKMEM is not set
CONFIG_SERIAL_LANTIQ=y
# CONFIG_HW_RANDOM is not set
CONFIG_I2C=y
CONFIG_I2C_FALCON=y
CONFIG_SPI=y
CONFIG_SPI_FALCON=y
CONFIG_GPIO_SYSFS=y
CONFIG_WATCHDOG=y
CONFIG_LANTIQ_WDT=y
# CONFIG_HID_SUPPORT is not set
# CONFIG_USB_SUPPORT is not set
CONFIG_TMPFS=y
CONFIG_JFFS2_FS=y
CONFIG_JFFS2_SUMMARY=y
CONFIG_JFFS2_FS_XATTR=y
CONFIG_JFFS2_COMPRESSION_OPTIONS=y
CONFIG_SQUASHFS=y
CONFIG_SQUASHFS_XZ=y
CONFIG_STRIP_ASM_SYMS=y
CONFIG_DEBUG_FS=y
```

## arch/tile/gxio/Kconfig
```kconfig
config TILE_GXIO
	bool "Tilera Gx I/O support"
	depends on TILEGX
	---help---
	  This option supports direct access to TILE-Gx hardware from
	  user space, via the gxio library, or from kernel space, via
	  kernel IORPC support.

config TILE_GXIO_DMA
	bool "Tilera Gx I/O DMA support"
	depends on TILE_GXIO
	---help---
	  This option supports direct access to the common I/O DMA facility
	  within the TILE-Gx mPIPE and Trio hardware.  It is not required
	  in order to use the gxio library to access mPIPE or Trio from
	  user space.

config TILE_GXIO_MPIPE
	bool "Tilera Gx mPIPE I/O support"
	select TILE_GXIO
	select TILE_GXIO_DMA
	---help---
	  This option supports direct access to the TILE-Gx mPIPE hardware
	  from kernel space.  It is not required in order to use the gxio
	  library to access mPIPE from user space.

config TILE_GXIO_TRIO
	bool "Tilera Gx TRIO I/O support"
	select TILE_GXIO
	select TILE_GXIO_DMA
	---help---
	  This option supports direct access to the TILE-Gx TRIO hardware
	  from kernel space.  It is not required in order to use the gxio
	  library to access TRIO from user space.
```

## arch/x86/platform/ts5500/Kconfig
```kconfig
config TS5500
	bool "Technologic Systems TS-5500 Single Board Computer support"
	depends on MELAN
  select CHECK_SIGNATURE
	help
	  Add support for the Technologic Systems TS-5500 platform features.

	  If you have a TS-5500, say Y here.

config TS5500_GPIO
	bool "TS-5500 GPIO support"
	depends on TS5500
	default y
	help
	  This enables support for the DIO headers for GPIO usage.

config TS5500_LED
	bool "TS-5500 LED Support"
	depends on TS5500 && LEDS_CLASS
	default y
	help
	  This option enables support for the on-chip LED.

config TS5500_ADC
	bool "TS-5500 ADC"
	depends on TS5500
	help
      Support for the A/D converter on Technologic Systems TS-5500 SBCs.
```

## drivers/modem_shm/Kconfig
```kconfig
#
# MODEM_SHM Framework
#

config MODEM_SHM
	tristate
	default n
	depends on EXPERIMENTAL

if MODEM_SHM && NET

menu "Modem Shared Memory"

config DUMMY_C2C
	tristate "Dummy C2C GENIO driver"
	depends on !C2C
	default MODEM_SHM
	---help---
	Say "Y" or "M" if you want to compile a dummy C2C driver.
	Use this if you want to compile without the real
	C2C driver available.
	If unsure say N.

config MODEM_SHM_BUS
	tristate
	default MODEM_SHM_DEV

config MODEM_SHM_BOOT
	tristate
	depends on MODEM_SHM_DEV
	default MODEM_SHM_DEV

config MODEM_SHM_DEV
	tristate "SHM Channels for Modem Shared Memory"
	depends on DUMMY_C2C || C2C
	select MODEM_SHM_BUS
	select MODEM_SHM_BOOT
	default MODEM_SHM
	---help---
	Say "Y" to use Modem Shared Memory IPC mechanism.
	SHM is an IPC protocol used to talk to external device such
	as modem over a shared memory (e.g. Chip to Chip).
	Only say "M" here if you want to test MODEM_SHM and need to load
	and unload its module.
	If unsure say N.

config MODEM_SHM_CHR
	tristate "Character device for Modem Shared Memory"
	depends on MODEM_SHM_DEV
	default MODEM_SHM_DEV
	---help---
	Say "Y" to use a character device for the Modem Shared
	Memory IPC mechanism. MODEM_SHM is an IPC protocol used to
	talk to external device such as modem over a shared memory
	(e.g. Chip to Chip).
	Only say "M" here if you want to test MODEM_SHM and need to load
	and unload its module.
	If unsure say N.

endmenu

endif
```

## drivers/net/wireless/mwl8k/Kconfig
```kconfig
config MWL8K_COMMON
	tristate "Marvell 88W8xxx PCI/PCIe Wireless support"
	depends on MAC80211 && PCI && WLAN_80211 && EXPERIMENTAL
	---help---
	  This is common code for Marvell TOPDOG 802.11 wireless cards.  This
	  module does nothing by itself - the device-specific front-ends
	  also need to be enabled in order to support any devices.

	  To compile this driver as a module, choose M here: the module
	  will be called mwl8k.  If unsure, say N.

config MWL8687
	tristate "Marvell 88W8687 PCI/PCIe Wireless support"
	depends on MWL8K_COMMON
	---help---
	  This driver is for Marvell TOPDOG 88w8687-based wireless cards.

	  To compile this driver as a module, choose M here: the module
	  will be called mwl8687.  If unsure, say N.

config MWL8366
	tristate "Marvell 88W8366 PCI/PCIe Wireless support"
	depends on MWL8K_COMMON
	---help---
	  This driver is for Marvell TOPDOG 88w8366-based wireless cards.

	  To compile this driver as a module, choose M here: the module
	  will be called mwl8366.  If unsure, say N.
```

## drivers/staging/media/hd29l2/Kconfig
```kconfig
config DVB_HD29L2
	tristate "HDIC HD29L2"
	depends on DVB_CORE && I2C
	default m if DVB_FE_CUSTOMISE
	help
	  Say Y when you want to support this frontend.
```

## drivers/vhost/Kconfig
```kconfig
config VHOST_NET
	tristate "Host kernel accelerator for virtio net (EXPERIMENTAL)"
	depends on NET && EVENTFD && (TUN || !TUN) && (MACVTAP || !MACVTAP) && EXPERIMENTAL
	---help---
	  This kernel module can be loaded in host kernel to accelerate
	  guest networking with virtio_net. Not to be confused with virtio_net
	  module itself which needs to be loaded in guest kernel.

	  To compile this driver as a module, choose M here: the module will
	  be called vhost_net.

config TCM_VHOST
	tristate "TCM_VHOST fabric module (EXPERIMENTAL)"
	depends on TARGET_CORE && EVENTFD && EXPERIMENTAL && m
	default n
	---help---
	Say M here to enable the TCM_VHOST fabric module for use with virtio-scsi guests
```

## drivers/xshm/Kconfig
```kconfig
#
# XSHM Framework
#

config XSHM
	tristate
	default n
	depends on EXPERIMENTAL

if XSHM && NET

menu "XSHM drivers and interfaces"

config DUMMY_C2C
	tristate "Dummy C2C GENIO driver"
	depends on !C2C
	default XSHM
	---help---
	Say "Y" or "M" if you want to compile a dummy C2C driver.
	Use this if you want to compile without the real
	C2C driver available.

config XSHM_BUS
	tristate
	default XSHM_DEV

config XSHM_BOOT
	tristate
	depends on XSHM_DEV
	default XSHM_DEV

config XSHM_DEV
	tristate "XSHM Channels for External Shared Memory (XSHM)"
	depends on DUMMY_C2C || C2C
	select XSHM_BUS
	select XSHM_BOOT
	default XSHM
	---help---
	Say "Y" to use External Shared Memory (XSHM) IPC mechanism.
	XSHM is an IPC protocol used to talk to external device such
	as modem over a shared memory (e.g. Chip to Chip).
	Only say "M" here if you want to test XSHM and need to load
	and unload its module.
	If unsure say N.

config XSHM_CHR
	tristate "Character device for External Shared Memory (XSHM)"
	depends on XSHM_DEV
	default XSHM_DEV
	---help---
	Say "Y" to use a character device for the External Shared
	Memory (XSHM) IPC mechanism. XSHM is an IPC protocol used to
	talk to external device such as modem over a shared memory
	(e.g. Chip to Chip).
	Only say "M" here if you want to test XSHM and need to load
	and unload its module.
	If unsure say N.

endmenu

endif
```

## sound/soc/sa11x0/Kconfig
```kconfig
config SND_SOC_SA11X0_SSP
	tristate
	depends on DMA_SA11X0
	select SND_SOC_DMAENGINE

config SND_SA11X0_ASSABET
	tristate "SoC Audio support for the Intel Assabet board"
	depends on SA1100_ASSABET && DMA_SA11X0
	select SND_SOC_L3
	select SND_SOC_UDA134X
	select SND_SOC_SA11X0_SSP
	help
	  Enable support for the audio UDA1341 codec found on the Intel
	  Assabet SA-1110 development board.
```
