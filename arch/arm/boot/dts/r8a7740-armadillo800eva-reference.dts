/*
 * Reference Device Tree Source for the armadillo 800 eva board
 *
 * Copyright (C) 2012 Renesas Solutions Corp.
 *
 * This file is licensed under the terms of the GNU General Public License
 * version 2.  This program is licensed "as is" without any warranty of any
 * kind, whether express or implied.
 */

/dts-v1/;
/include/ "r8a7740.dtsi"

/ {
	model = "armadillo 800 eva";
	compatible = "renesas,armadillo800eva-reference", "renesas,r8a7740";

	chosen {
		bootargs = "console=tty0 console=ttySC1,115200 earlyprintk=sh-sci.1,115200 ignore_loglevel root=/dev/nfs ip=dhcp nfsroot=,rsize=4096,wsize=4096 rw";
	};

	memory {
		device_type = "memory";
		reg = <0x40000000 0x20000000>;
	};

	sh-eth@e9a00000 {
		compatible = "renesas,sh-eth";
		interrupt-parent = <&intca>;
		reg = <0xe9a00000 0x800>, <0xe9a01800 0x800>;
		interrupts = <0x500>;
		phy-mode = "mii";
		sh-eth,edmac-endian = "little";
		sh-eth,register-type = "gigabit";
		sh-eth,phy-id = <0>;
	};
};
